## drivers/battery/Kconfig
```kconfig
config BATTERY_SAMSUNG
	tristate "samsung battery driver"
	help
	 Say Y to include support for samsung battery driver
	 This battery driver integrated all battery-related functions
	 To see battery-related functions,
	 refer to sec_charging_common.h


# Fuel Gauge

config FUELGAUGE_AB8500
	tristate "use AB8500 fuel gauge"
	default n
	depends on BATTERY_SAMSUNG
	help
	 Say Y to include support
	 for STE AB8500 fuel gauge driver.
	 This driver source code implemented
	 all functions for AB8500 charger.

# Charger

config CHARGER_AB8500
	tristate "AB8500 charger driver"
	default n
	depends on BATTERY_SAMSUNG
	help
	 Say Y to include support
	 for STE AB8500 charger driver.
	 This driver source code implemented
	 all functions for AB8500 charge
```

## sound/soc/ux500/Kconfig
```kconfig
#
# Ux500 SoC audio configuration
#

config SND_SOC_UX500_AB8500
	bool "Codec - AB8500"
	depends on SND_SOC_UX500 && UX500_SOC_DB8500 && AB8500_CORE && AB8500_GPADC
	select SND_SOC_AB8500
	default n
	help
		Say Y if you want to include AB8500 audio codec.
```
